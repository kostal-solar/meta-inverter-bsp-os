## conf/distro/kostal.conf
```bitbake
require conf/distro/poky.conf
DISTRO = "kostal"
DISTRO_NAME = "Kostal Wechselrichter Distro"

DISTRO_FEATURES_append = " systemd"
VIRTUAL-RUNTIME_init_manager = "systemd"
VIRTUAL-RUNTIME_initscripts = "systemd-compat-units"
DISTRO_FEATURES_BACKFILL_CONSIDERED += "sysvinit"
```

## conf/layer.conf
```bitbake
# We have a conf and classes directory, append to BBPATH
BBPATH .= ":${LAYERDIR}"

# We have a recipes directory, add to BBFILES
BBFILES += "${LAYERDIR}/recipes*/*/*.bb ${LAYERDIR}/recipes*/*/*.bbappend"

BBFILE_COLLECTIONS += "kostal-bsp"
BBFILE_PATTERN_kostal-bsp := "^${LAYERDIR}/"
BBFILE_PRIORITY_kostal-bsp = "10"

LICENSE_PATH += "${LAYERDIR}/licenses"

LAYERSERIES_COMPAT_kostal-bsp = "zeus dunfell"

#BBFILES_DYNAMIC += " \
#    secure-imx:${LAYERDIR}/dynamic-layers/meta-secure-imx/*/*/*.bbappend \
#"
```

## conf/machine/kie-inverter.inc
```bitbake
#@TYPE: Machine
#@NAME: Kostal 'inverter' board

include conf/machine/include/tune-cortexa7.inc

UBOOT_NAME = "u-boot-ivt"
UBOOT_ENTRYPOINT = "0x87800000"
UBOOT_MAKE_TARGET = ""
UBOOT_SUFFIX = "img"
SPL_BINARY = "SPL"
UBOOT_BINARY = "${UBOOT_NAME}.${UBOOT_SUFFIX}"
UBOOT_CONFIG = "emmc"
UBOOT_CONFIG[emmc] = "kostal_kie_ull_defconfig"
UBOOT_SIGN_SUFFIX = "signed"

PREFERRED_PROVIDER_virtual/bootloader = "u-boot"
PREFERRED_PROVIDER_u-boot = "u-boot"
PREFERRED_PROVIDER_u-boot-tools = "u-boot-tools"
PREFERRED_PROVIDER_u-boot-tools-native = "u-boot-tools-native"
PREFERRED_PROVIDER_u-boot-mkimage = "u-boot-tools"
PREFERRED_PROVIDER_u-boot-mkimage-native = "u-boot-tools-native"

FITLOADADDR ?= "0x82000000"

PREFERRED_PROVIDER_virtual/kernel ?= "linux-stable"
PREFERRED_VERSION_linux-stable ?= "5.4.%"
KERNEL_DEVICETREE = "imx6ull-kie-inverter.dtb imx6ul-kie-inverter.dtb"
INITRAMFS_IMAGE = "kie-initramfs"

KERNEL_CLASSES += "kernel-fitimage"
KERNEL_IMAGETYPE = "fitImage"
KERNEL_SIGN_SUFFIX = "signed"

SERIAL_CONSOLES="115200;ttymxc0"

IMAGE_BOOT_FILES = "fitImage"
EXTRA_IMAGEDEPENDS += "u-boot"

include conf/machine/include/crypt.inc
include conf/machine/include/swu.inc

# Signing the SWUpdate image
SWUPDATE_SIGNING ?= "RSA"
SWUPDATE_PRIVATE_KEY ?= "${TOPDIR}/keys/conf/swu/inverter_pki_priv.pem"
SWUPDATE_PUBLIC_KEY ?= "${TOPDIR}/keys/conf/swu/inverter_pki_public.pem"
SWUPDATE_PASSWORD_FILE ?= "${TOPDIR}/keys/conf/swu/inverter_pki_priv.pass"
```

## conf/machine/mx6rul-kie-inverter.conf
```bitbake
include kie-inverter.inc

# imx6ul can use newest 3.3.2 CST tool
PREFERRED_VERSION_cst-native ?= "3.3.2"

# imx6ul has the 'CAAM' crypto acceleration HW
CRYPTO_HW_ACCEL = "CAAM"
```

## conf/machine/mx6ul-kie-inverter.conf
```bitbake
include kie-inverter.inc

# imx6ull requires 3.1.0 CST tool
PREFERRED_VERSION_cst-native ?= "3.1.0"

# imx6ull only has the 'DCP' crypto acceleration HW, but
# according to ERRATA (ERR010449) DCP can be only used by BootROM in
# HAB context only with disabled MMU/CACHE.
# As a result - the software engine 'SW' is used to keep caches/MMU
# enabled for signature checking.
# The other option is to set (fuse) 'BT_MMU_DISABLE'
CRYPTO_HW_ACCEL = "SW"
```
